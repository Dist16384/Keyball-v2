## boards/shields/mona2/Kconfig.defconfig
```kconfig
if SHIELD_KEYBALLBLE_R

config ZMK_KEYBOARD_NAME
    default "KEYBALLBLE"

config ZMK_BLE
    default y

config ZMK_SPLIT_ROLE_CENTRAL
    default y

config INPUT
    default y

config ZMK_POINTING
    default y

config SPI
    default y

config PMW3610
    default y

endif

if SHIELD_KEYBALLBLE_R || SHIELD_KEYBALLBLE_L

config NFCT_PINS_AS_GPIOS
    default y

config ZMK_SPLIT
    default y

config RGBLED_WIDGET_BATTERY_LEVEL_HIGH
    default 30

config RGBLED_WIDGET_BATTERY_LEVEL_CRITICAL
    default 10

endif
```

## boards/shields/mona2/Kconfig.shield
```kconfig
config SHIELD_KEYBALLBLE_R
    def_bool $(shields_list_contains,KeyballBLE-M _r)

config SHIELD_KEYBALLBLE_L
    def_bool $(shields_list_contains,KeyballBLE-M _l)
```
